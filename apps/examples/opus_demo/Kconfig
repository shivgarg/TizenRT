## apps/examples/opus_demo/Kconfig
```kconfig
#
# For a description of the syntax of this configuration file,
# see kconfig-language at https://www.kernel.org/doc/Documentation/kbuild/kconfig-language.txt
#

config EXAMPLES_OPUSDEMO
	bool "opus codec demo"
	default y 
	---help---
		Enable opus codec demo
```

## external/libopus/Kconfig
```kconfig
#
# For a description of the syntax of this configuration file,
# see kconfig-language at https://www.kernel.org/doc/Documentation/kbuild/kconfig-language.txt
#

config AUDIO_LIBOPUS
	bool "AUDIO_LIBOPUS"
	default n
	depends on AUDIO
	---help---
		enable libopus encoder-decoder feature
```
